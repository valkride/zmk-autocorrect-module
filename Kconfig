## Kconfig
```kconfig
config ZMK_AUTOCORRECT
    bool "Enable ZMK Autocorrect Module"
    default y
    help
      Enable autocorrect functionality for common typos
```

## dts/bindings/behaviors/zmk,behavior-autocorrect.yaml
```yaml
description: Autocorrect behavior

compatible: "zmk,behavior-autocorrect"

include: one_param.yaml

properties:
  label:
    type: string
    required: true
  #display-name:
  #  type: string
```
